## conf/machine/spycat.conf
```bitbake
#@TYPE: Machine
#@NAME: SPYCAT Spycat
#@DESCRIPTION: Machine configuration for the SPYCAT Spycat

SOC_FAMILY = "bcm7362"
CHIPSET = "bcm7362"

BRAND_OEM = "xcore"
MACHINE_BRAND = "SPYCAT"
MACHINE_NAME = "SpyCat"

KERNEL_FILE = "kernel.bin"
ROOTFS_FILE = "rootfs.bin"
MTD_KERNEL = "mtd0"
MTD_ROOTFS = "mtd2"

MACHINE_FEATURES += " HDMI videoenhancement blindscan-dvbs blindscan-dvbc ci dvb-c skins1080 textlcd"

PREFERRED_VERSION_linux-spycat = "4.11"

KERNEL_IMAGETYPE = "vmlinux.gz"
KERNEL_CONSOLE = "ttyS0,115200n8"

KERNEL_MODULE_AUTOLOAD += "r8723bs"
KERNEL_MODULE_AUTOLOAD += "hci_uart"

require conf/machine/include/spycat-mipsel.inc
```

## conf/machine/spycatmini.conf
```bitbake
#@TYPE: Machine
#@NAME: SPYCAT Spycatmini
#@DESCRIPTION: Machine configuration for the SPYCAT Spycatmini

SOC_FAMILY = "bcm7362"
CHIPSET = "bcm7362"

BRAND_OEM = "xcore"
MACHINE_BRAND = "SPYCAT"
MACHINE_NAME = "SpyCat mini"

KERNEL_FILE = "kernel.bin"
ROOTFS_FILE = "rootfs.bin"
MTD_KERNEL = "mtd0"
MTD_ROOTFS = "mtd2"

MACHINE_FEATURES += " HDMI videoenhancement blindscan-dvbs blindscan-dvbc ci dvb-c skins1080 textlcd 7segment"

PREFERRED_VERSION_linux-spycat = "4.11"

KERNEL_IMAGETYPE = "vmlinux.gz"
KERNEL_CONSOLE = "ttyS0,115200n8"

KERNEL_MODULE_AUTOLOAD += "r8723bs"
KERNEL_MODULE_AUTOLOAD += "hci_uart"

require conf/machine/include/spycat-mipsel.inc
```

## conf/machine/spycatminiplus.conf
```bitbake
#@TYPE: Machine
#@NAME: SPYCAT Spycatmini+
#@DESCRIPTION: Machine configuration for the SPYCAT Spycatmini+

SOC_FAMILY = "bcm73625"
CHIPSET = "bcm73625"

BRAND_OEM = "xcore"
MACHINE_BRAND = "SPYCAT"
MACHINE_NAME = "SpyCat mini +"

FRIENDLY_FAMILY = "xc7362"
STB_PLATFORM = "xcs7362"
MACHINE_MODEL = "xc7362"

KERNEL_FILE = "kernel.bin"
ROOTFS_FILE = "rootfs.bin"
MTD_KERNEL = "mtd0"
MTD_ROOTFS = "mtd2"

MACHINE_FEATURES += " HDMI videoenhancement blindscan-dvbs blindscan-dvbc ci dvb-c skins1080 textlcd 7segment h265"

PREFERRED_VERSION_linux-spycat = "4.11"

KERNEL_IMAGETYPE = "vmlinux.gz"
KERNEL_CONSOLE = "ttyS0,115200n8"

KERNEL_MODULE_AUTOLOAD += "r8723bs"
KERNEL_MODULE_AUTOLOAD += "hci_uart"

require conf/machine/include/spycat-mipsel.inc
```
